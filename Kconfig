## Kconfig
```kconfig
config RTL8192CU
	tristate "Realtek 8192C USB WiFi"
        select WIRELESS_EXT
        select WEXT_CORE
        select WEXT_PRIV
	depends on USB
	---help---
	  Help message of RTL8192CU
```
